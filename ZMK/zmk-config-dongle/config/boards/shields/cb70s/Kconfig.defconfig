## ZMK/zmk-config-dongle/config/boards/shields/cb70s/Kconfig.defconfig
```kconfig
if SHIELD_MY_BOARD_DONGLE

config ZMK_KEYBOARD_NAME
	default "CB70SD"

config ZMK_SPLIT_BLE_ROLE_CENTRAL
	default y

config ZMK_SPLIT
	default y

config ZMK_SPLIT_BLE_CENTRAL_PERIPHERALS
	default 2

config BT_MAX_CONN
	default 6

config BT_MAX_PAIRED
	default 6

endif
```

## ZMK/zmk-config-non-dongle/config/boards/shields/cb70s/Kconfig.shield
```kconfig
config SHIELD_MY_BOARD_LEFT
def_bool $(shields_list_contains,cb70s_left)

config SHIELD_MY_BOARD_RIGHT
def_bool $(shields_list_contains,cb70s_right)
```

## ZMK/zmk-config/non-dongle/config/boards/shields/cb70s/Kconfig.defconfig
```kconfig
if SHIELD_MY_BOARD_LEFT

config ZMK_KEYBOARD_NAME
	default "CB70S"

config ZMK_SPLIT_BLE_ROLE_CENTRAL
	default y

endif

if SHIELD_MY_BOARD_LEFT || SHIELD_MY_BOARD_RIGHT

config ZMK_SPLIT
	default y

endif
```
